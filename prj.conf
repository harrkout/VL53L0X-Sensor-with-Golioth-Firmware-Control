## CMakeLists.txt
```
# SPDX-License-Identifier: Apache-2.0

cmake_minimum_required(VERSION 3.20.0)
find_package(Zephyr REQUIRED HINTS $ENV{ZEPHYR_BASE})
project(vl53l0x_harry_mcu)

FILE(GLOB app_sources src/*.c)
target_sources(app PRIVATE ${app_sources})
```

## prj.conf
```kconfig
#taken from /home/harrkout/zephyr/samples/sensor/vl53l0x/prj.conf

CONFIG_STDOUT_CONSOLE=y
CONFIG_I2C=y
CONFIG_GPIO=y
CONFIG_SENSOR=y
CONFIG_VL53L0X=y
CONFIG_VL53L0X_PROXIMITY_THRESHOLD=100

#debug
#CONFIG_DEBUG=y
#CONFIG_LOG=y
#CONFIG_SENSOR_LOG_LEVEL_DBG=y
CONFIG_CBPRINTF_FP_SUPPORT=y


#Taken from /home/harrkout/modules/lib/golioth/samples/lightdb_stream/prj.conf

# Generic networking options
CONFIG_NETWORKING=y
CONFIG_NET_IPV4=y
CONFIG_NET_IPV6=n

# Logging
CONFIG_NET_LOG=y

# Network Shell
CONFIG_NET_SHELL=y

# TLS configuration
CONFIG_MBEDTLS_ENABLE_HEAP=y
CONFIG_MBEDTLS_HEAP_SIZE=10240
CONFIG_MBEDTLS_SSL_MAX_CONTENT_LEN=2048

# Application
CONFIG_MAIN_STACK_SIZE=4096
CONFIG_EVENTFD=y

CONFIG_GOLIOTH=y
CONFIG_GOLIOTH_SYSTEM_CLIENT=y

CONFIG_MINIMAL_LIBC_MALLOC_ARENA_SIZE=1024

# MCUboot

CONFIG_BOOTLOADER_MCUBOOT=y
CONFIG_FLASH=y
CONFIG_FLASH_MAP=y
CONFIG_IMG_MANAGER=y
CONFIG_IMG_ERASE_PROGRESSIVELY=y
CONFIG_REBOOT=y
CONFIG_LOG_STRDUP_BUF_COUNT=8
CONFIG_GOLIOTH_FW=y


# Wifi
CONFIG_WIFI=y
CONFIG_WIFI_ESP_AT=y
CONFIG_WIFI_ESP_AT_MDM_RX_BUF_COUNT=40

CONFIG_NET_L2_WIFI_SHELL=y
CONFIG_GOLIOTH_SAMPLE_WIFI=y

CONFIG_GOLIOTH_SYSTEM_CLIENT_PSK_ID="secret@l475"
CONFIG_GOLIOTH_SYSTEM_CLIENT_PSK="secret_id"

CONFIG_GOLIOTH_SAMPLE_WIFI_SSID=""
CONFIG_GOLIOTH_SAMPLE_WIFI_PSK=""
```

## src/main.c
```c
/*
 * @file main.c
 * @brief Golioth LightDB Stream of Time-of-Flight Sensor
 * @date 01/06/22
 * @author Harry Koutsourelakis
 */

// Golioth's header files
#include <logging/log.h>
LOG_MODULE_REGISTER(golioth_lightdb_stream, LOG_LEVEL_DBG);

#include <net/coap.h>
#include <net/golioth/system_client.h>
#include <net/golioth/wifi.h>

#include <drivers/sensor.h>
#include <stdlib.h>

// VL53L0X header files
#include <zephyr.h>
#include <device.h>
#include <drivers/sensor.h>
#include <stdio.h>
#include <sys/printk.h>

// MCUboot
#include <sys/reboot.h>
#include <net/golioth/fw.h>
#include "flash.h"

#define REBOOT_DELAY_SEC 1

/**
 * @struct dfu_ctx
 * @brief Structure for firmware update context
 */
struct dfu_ctx {
    struct golioth_fw_download_ctx fw_ctx; /**< Golioth firmware download context */
    struct flash_img_context flash;        /**< Flash image context for firmware update */
    char version[65];                      /**< Firmware version */
};

static struct dfu_ctx update_ctx; /**< Firmware update context instance */
static enum golioth_dfu_result dfu_initial_result = GOLIOTH_DFU_RESULT_INITIAL; /**< Initial firmware update result */

/**
 * @brief Callback function for handling received firmware data
 * @param ctx Firmware download context
 * @param data Received data buffer
 * @param offset Offset in firmware image
 * @param len Length of received data
 * @param last Indicates if this is the last data chunk
 * @return 0 on success, negative error code on failure
 */
static int data_received(struct golioth_blockwise_download_ctx *ctx, const uint8_t *data, size_t offset, size_t len, bool last)
{
    struct dfu_ctx *dfu = CONTAINER_OF(ctx, struct dfu_ctx, fw_ctx);
    int err;

    LOG_DBG("Received %zu bytes at offset %zu%s", len, offset, last ? " (last)" : "");

    if (offset == 0) {
        err = flash_img_prepare(&dfu->flash);
        if (err) {
            return err;
        }
    }

    err = flash_img_buffered_write(&dfu->flash, data, len, last);
    if (err) {
        LOG_ERR("Failed to write to flash: %d", err);
        return err;
    }

    if (offset > 0 && last) {
        err = golioth_fw_report_state(client, "main", current_version_str, dfu->version, GOLIOTH_FW_STATE_DOWNLOADED, GOLIOTH_DFU_RESULT_INITIAL);
        if (err) {
            LOG_ERR("Failed to update to '%s' state: %d", "downloaded", err);
        }

        err = golioth_fw_report_state(client, "main", current_version_str, dfu->version, GOLIOTH_FW_STATE_UPDATING, GOLIOTH_DFU_RESULT_INITIAL);
        if (err) {
            LOG_ERR("Failed to update to '%s' state: %d", "updating", err);
        }

        LOG_INF("Requesting upgrade");

        err = boot_request_upgrade(BOOT_UPGRADE_TEST);
        if (err) {
            LOG_ERR("Failed to request upgrade: %d", err);
            return err;
        }

        LOG_INF("Rebooting in %d second(s)", REBOOT_DELAY_SEC);

        /* Synchronize logs */
        LOG_PANIC();

        k_sleep(K_SECONDS(REBOOT_DELAY_SEC));

        sys_reboot(SYS_REBOOT_COLD);
    }

    return 0;
}

/**
 * @brief Strips the leading slash from a URI
 * @param uri URI string
 * @param uri_len Length of the URI string
 * @return Updated URI string without the leading slash
 */
static uint8_t *uri_strip_leading_slash(uint8_t *uri, size_t *uri_len)
{
    if (*uri_len > 0 && uri[0] == '/') {
        (*uri_len)--;
        return &uri[1];
    }

    return uri;
}

/**
 * @brief Callback function for handling desired firmware update
 * @param update CoAP packet containing the update information
 * @param reply CoAP reply structure
 * @param from Source address of the CoAP packet
 * @return 0 on success, negative error code on failure
 */
static int golioth_desired_update(const struct coap_packet *update, struct coap_reply *reply, const struct sockaddr *from)
{
    struct dfu_ctx *dfu = &update_ctx;
    struct coap_reply *fw_reply;
    const uint8_t *payload;
    uint16_t payload_len;
    size_t version_len = sizeof(dfu->version) - 1;
    uint8_t uri[64];
    uint8_t *uri_p;
    size_t uri_len = sizeof(uri);
    int err;

    payload = coap_packet_get_payload(update, &payload_len);
    if (!payload) {
        LOG_ERR("No payload in CoAP!");
        return -EIO;
    }

    LOG_HEXDUMP_DBG(payload, payload_len, "Desired");

    err = golioth_fw_desired_parse(payload, payload_len, dfu->version, &version_len, uri, &uri_len);
    if (err) {
        LOG_ERR("Failed to parse desired version: %d", err);
        return err;
    }

    dfu->version[version_len] = '\0';

    if (version_len == strlen(current_version_str) && !strncmp(current_version_str, dfu->version, version_len)) {
        LOG_INF("Desired version (%s) matches current firmware version!", log_strdup(current_version_str));
        return -EALREADY;
    }

    fw_reply = coap_reply_next_unused(coap_replies, ARRAY_SIZE(coap_replies));
    if (!reply) {
        LOG_ERR("No more reply handlers");
        return -ENOMEM;
    }

    uri_p = uri_strip_leading_slash(uri, &uri_len);

    err = golioth_fw_report_state(client, "main", current_version_str, dfu->version, GOLIOTH_FW_STATE_DOWNLOADING, GOLIOTH_DFU_RESULT_INITIAL);
    if (err) {
        LOG_ERR("Failed to update to '%s' state: %d", "downloading", err);
    }

    err = golioth_fw_download(client, &dfu->fw_ctx, uri_p, uri_len, fw_reply, data_received);
    if (err) {
        LOG_ERR("Failed to request firmware: %d", err);
        return err;
    }

    return 0;
}

/**
 * @brief Callback function on Golioth client connect
 * @param client Golioth client instance
 */
static void golioth_on_connect(struct golioth_client *client)
{
    struct coap_reply *reply;
    int err;
    int i;

    err = golioth_fw_report_state(client, "main", current_version_str, NULL, G
```

## src/flash.c
```c
/*
 * Copyright (c) 2021 Golioth, Inc.
 *
 * SPDX-License-Identifier: Apache-2.0
 */

/**
 * @file
 * @brief Golioth Device Firmware Update (DFU) module
 */

#include <logging/log.h>
LOG_MODULE_DECLARE(golioth_dfu);

#include <stdio.h>
#include <storage/flash_map.h>

#include "flash.h"

/* FLASH_AREA_ID() values used below are auto-generated by DT */
#ifdef CONFIG_TRUSTED_EXECUTION_NONSECURE
#define FLASH_AREA_IMAGE_PRIMARY FLASH_AREA_ID(image_0_nonsecure)
#define FLASH_AREA_IMAGE_SECONDARY FLASH_AREA_ID(image_1_nonsecure)
#else
#define FLASH_AREA_IMAGE_PRIMARY FLASH_AREA_ID(image_0)
#if FLASH_AREA_LABEL_EXISTS(image_1)
#define FLASH_AREA_IMAGE_SECONDARY FLASH_AREA_ID(image_1)
#endif
#endif /* CONFIG_TRUSTED_EXECUTION_NONSECURE */

/**
 * @brief String to store the current firmware version
 */
char current_version_str[sizeof("255.255.65535")];

/**
 * @brief Initializes the current firmware version string
 *
 * @param dev Unused parameter (required by Zephyr SYS_INIT macro)
 * @return 0 on success, negative error code on failure
 */
static int current_version_init(const struct device *dev)
{
    struct mcuboot_img_header hdr;
    int written;
    int err;

    err = boot_read_bank_header(FLASH_AREA_IMAGE_PRIMARY, &hdr, sizeof(hdr));
    if (err) {
        LOG_ERR("Failed to read primary area (%u) header: %d",
                FLASH_AREA_IMAGE_PRIMARY, err);
        return err;
    }

    written = snprintf(current_version_str, sizeof(current_version_str),
                       "%u.%u.%u",
                       (unsigned int)hdr.h.v1.sem_ver.major,
                       (unsigned int)hdr.h.v1.sem_ver.minor,
                       (unsigned int)hdr.h.v1.sem_ver.revision);
    if (written >= sizeof(current_version_str)) {
        LOG_ERR("Version string is too long!");
        current_version_str[0] = '\0';
        return -ENOMEM;
    }

    return 0;
}

SYS_INIT(current_version_init, APPLICATION, CONFIG_APPLICATION_INIT_PRIORITY);

/**
 * @brief Macro to create a 32-bit value with all bytes set to a given value
 */
#define ERASED_VAL_32(x) (((x) << 24) | ((x) << 16) | ((x) << 8) | (x))

/**
 * @brief Determines if the specified area of flash is completely unwritten.
 *
 * @param fa Flash area to check
 * @param[out] out_empty True if the area is empty, false otherwise
 * @return 0 on success, negative error code on failure
 */
static int flash_area_check_empty(const struct flash_area *fa,
                                  bool *out_empty)
{
    uint32_t data[16];
    off_t addr;
    off_t end;
    int bytes_to_read;
    int rc;
    int i;
    uint8_t erased_val;
    uint32_t erased_val_32;

    __ASSERT_NO_MSG(fa->fa_size % 4 == 0);

    erased_val = flash_area_erased_val(fa);
    erased_val_32 = ERASED_VAL_32(erased_val);

    end = fa->fa_size;
    for (addr = 0; addr < end; addr += sizeof(data)) {
        if (end - addr < sizeof(data)) {
            bytes_to_read = end - addr;
        } else {
            bytes_to_read = sizeof(data);
        }

        rc = flash_area_read(fa, addr, data, bytes_to_read);
        if (rc != 0) {
            flash_area_close(fa);
            return rc;
        }

        for (i = 0; i < bytes_to_read / 4; i++) {
            if (data[i] != erased_val_32) {
                *out_empty = false;
                flash_area_close(fa);
                return 0;
            }
        }
    }

    *out_empty = true;

    return 0;
}

/**
 * @brief Checks if the flash image area needs to be erased and performs the erase if necessary
 *
 * @param ctx Flash image context
 * @return 0 on success, negative error code on failure
 */
static int flash_img_erase_if_needed(struct flash_img_context *ctx)
{
    bool empty;
    int err;

    if (IS_ENABLED(CONFIG_IMG_ERASE_PROGRESSIVELY)) {
        return 0;
    }

    err = flash_area_check_empty(ctx->flash_area, &empty);
    if (err) {
        return err;
    }

    if (empty) {
        return 0;
    }

    err = flash_area_erase(ctx->flash_area, 0, ctx->flash_area->fa_size);
    if (err) {
        return err;
    }

    return 0;
}

/**
 * @brief Converts swap type to a string representation
 *
 * @param swap_type Swap type to convert
 * @return String representation of the swap type
 */
static const char *swap_type_str(int swap_type)
{
    switch (swap_type) {
    case BOOT_SWAP_TYPE_NONE:
        return "none";
    case BOOT_SWAP_TYPE_TEST:
        return "test";
    case BOOT_SWAP_TYPE_PERM:
        return "perm";
    case BOOT_SWAP_TYPE_REVERT:
        return "revert";
    case BOOT_SWAP_TYPE_FAIL:
        return "fail";
    }

    return "unknown";
}

/**
 * @brief Prepares the flash image for an update
 *
 * @param flash Flash image context
 * @return 0 on success, negative error code on failure
 */
int flash_img_prepare(struct flash_img_context *flash)
{
    int swap_type;
    int err;

    swap_type = mcuboot_swap_type();
    switch (swap_type) {
    case BOOT_SWAP_TYPE_REVERT:
        LOG_WRN("'revert' swap type detected, it is not safe to continue");
        return -EBUSY;
    default:
        LOG_INF("swap type: %s", swap_type_str(swap_type));
        break;
    }

    err = flash_img_init(flash);
    if (err) {
        LOG_ERR("failed to init: %d", err);
        return err;
    }

    err = flash_img_erase_if_needed(flash);
    if (err) {
        LOG_ERR("failed to erase: %d", err);
        return err;
    }

    return 0;
}
```

## src/flash.h
```c
/*
 * Copyright (c) 2021 Golioth, Inc.
 *
 * SPDX-License-Identifier: Apache-2.0
 */

#ifndef __APP_FLASH_H__
#define __APP_FLASH_H__

#ifdef CONFIG_BOOTLOADER_MCUBOOT

#include <dfu/flash_img.h>
#include <dfu/mcuboot.h>
#include <zephyr/types.h>

/**
 * @file
 * @brief Application-specific flash handling header
 */

/**
 * @brief Prepares the flash image for an update
 *
 * This function prepares the flash image for an update based on the
 * configuration specified in the flash image context.
 *
 * @param flash Flash image context
 * @return 0 on success, negative error code on failure
 */
int flash_img_prepare(struct flash_img_context *flash);

/**
 * @brief String to store the current firmware version
 */
extern char current_version_str[sizeof("255.255.65535")];

#else /* CONFIG_BOOTLOADER_MCUBOOT */

#include <stdbool.h>
#include <stddef.h>
#include <stdint.h>

/**
 * @brief Structure representing the context for flash image handling
 */
struct flash_img_context {
    /* empty */
};

/**
 * @brief Prepares the flash image for an update
 *
 * This is a placeholder function for platforms not using the MCUBOOT bootloader.
 *
 * @param flash Flash image context (unused)
 * @return Always returns 0
 */
static inline int flash_img_prepare(struct flash_img_context *flash)
{
    return 0;
}

/**
 * @brief Writes data to the flash image buffer
 *
 * This is a placeholder function for platforms not using the MCUBOOT bootloader.
 *
 * @param ctx Flash image context (unused)
 * @param data Pointer to the data to be written
 * @param len Length of the data to be written
 * @param flush Flag indicating whether to flush the buffer (unused)
 * @return Always returns 0
 */
static inline
int flash_img_buffered_write(struct flash_img_context *ctx, const uint8_t *data,
                             size_t len, bool flush)
{
    return 0;
}

/** Boot upgrade request modes */
#define BOOT_UPGRADE_TEST       0 /**< Test upgrade mode */
#define BOOT_UPGRADE_PERMANENT  1 /**< Permanent upgrade mode */

/**
 * @brief Requests a boot upgrade with specified mode
 *
 * This is a placeholder function for platforms not using the MCUBOOT bootloader.
 *
 * @param permanent Upgrade mode (0 for test, 1 for permanent)
 * @return Always returns 0
 */
static inline int boot_request_upgrade(int permanent)
{
    return 0;
}

/**
 * @brief Checks if the image is confirmed
 *
 * This is a placeholder function for platforms not using the MCUBOOT bootloader.
 *
 * @return Always returns true
 */
static inline bool boot_is_img_confirmed(void)
{
    return true;
}

/**
 * @brief Writes the image confirmation
 *
 * This is a placeholder function for platforms not using the MCUBOOT bootloader.
 *
 * @return Always returns 0
 */
static inline int boot_write_img_confirmed(void)
{
    return 0;
}

/**
 * @brief String to store the current firmware version
 */
static char current_version_str[sizeof("255.255.65535")] = "1.0.0";

#endif /* CONFIG_BOOTLOADER_MCUBOOT */

#endif /* __APP_FLASH_H__ */
```
